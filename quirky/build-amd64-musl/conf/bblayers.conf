## quirky/build-amd64-musl/conf/bblayers.conf
```bitbake
# POKY_BBLAYERS_CONF_VERSION is increased each time build/conf/bblayers.conf
# changes incompatibly
POKY_BBLAYERS_CONF_VERSION = "2"

BBPATH = "${TOPDIR}"
BBFILES ?= ""

BBLAYERS ?= " \
  QPATH/meta \
  QPATH/meta-oe \
  QPATH/meta-python \
  QPATH/meta-perl \
  QPATH/meta-filesystems \
  QPATH/meta-networking \
  QPATH/meta-poky \
  QPATH/meta-yocto-bsp \
  QPATH/meta-quirky-cut \
  "
```

## quirky/build-amd64-musl/conf/local.conf
```bitbake
USER_CLASSES ?= "buildstats"

PATCHRESOLVE = "noop"

BB_DISKMON_DIRS ??= "\
    STOPTASKS,${TMPDIR},1G,100K \
    STOPTASKS,${DL_DIR},1G,100K \
    STOPTASKS,${SSTATE_DIR},1G,100K \
    STOPTASKS,/tmp,100M,100K \
    HALT,${TMPDIR},100M,1K \
    HALT,${DL_DIR},100M,1K \
    HALT,${SSTATE_DIR},100M,1K \
    HALT,/tmp,10M,1K"

PACKAGECONFIG:append:pn-qemu-native = " sdl"
PACKAGECONFIG:append:pn-nativesdk-qemu = " sdl"

CONF_VERSION = "2"

#BK ref: https://docs.yoctoproject.org/dev/dev-manual/efficiently-fetching-sources.html
BB_GENERATE_MIRROR_TARBALLS = "1"
DL_DIR = "/mnt/build/builds/oe/scarthgap/downloads"
#20240106 setup my source mirror:
#SOURCE_MIRROR_URL ?= "file://"
#INHERIT += "own-mirrors"
#MIRRORS is the last resort...
#MIRRORS:append = "https://.*/.* https://distro.ibiblio.org/easyos/source/oe/scarthgap/ \n"
#MIRRORS += "\
#https://distro.ibiblio.org/easyos/source/oe/scarthgap/ \n"

MACHINE ??= "genericx86-64"
DISTRO ?= "poky"
EXTRA_IMAGE_FEATURES ?= ""

PACKAGE_CLASSES ?= "package_deb"

INITRAMFS_MAXSIZE = "163840"

DISTRO_FEATURES:remove = "systemd"
DISTRO_FEATURES_BACKFILL_CONSIDERED += "systemd"

DISTRO_FEATURES:remove = "ptest"
DISTRO_FEATURES:remove = "vulkan"
DISTRO_FEATURES:remove = "pcmcia"
DISTRO_FEATURES:remove = "multiarch"

LICENSE_FLAGS_ACCEPTED += "commercial"

#20230903 add usrmerge
DISTRO_FEATURES:append = " opengl ldconfig usrmerge"
PACKAGE_CLASSES ?= "package_deb"

DISTRO_FEATURES:remove = "zeroconf"
DISTRO_FEATURES:remove = "wayland"

WARN_QA:remove = "patch-fuzz"
WARN_QA:remove = "host-user-contaminated"
ERROR_QA:remove = "installed-vs-shipped"
ERROR_QA:remove = "unknown-configure-option"
ERROR_QA:remove = "already-stripped"
ERROR_QA:remove = "ldflags"
#20230910 get this src from github tags...
WARN_QA:remove = "src-uri-bad"
ERROR_QA:remove = "patch-status"
ERROR_QA:remove = "pkgvarcheck"

TCLIBC = "musl"

PARALLEL_MAKE = "-j 2"
PARALLEL_MAKEINST = "-j 2"
BB_NUMBER_THREADS = "4"

#this globally changes the base revision from r0...
#20230903 bump to r1
PR = "r1"
#.bbappend recipes can use this to bump PR. ex: PR = "r${@int(PR_NUM) + 1}"
PR_NUM = "1"

##################################

IMAGE_INSTALL:append = " libcap-static"

#20240923 note libbzip2.a only, no utilities...
IMAGE_INSTALL:append = " bzip2-static"
```

## quirky/build-amd64/conf/bblayers.conf
```bitbake
# POKY_BBLAYERS_CONF_VERSION is increased each time build/conf/bblayers.conf
# changes incompatibly
POKY_BBLAYERS_CONF_VERSION = "2"

BBPATH = "${TOPDIR}"
BBFILES ?= ""

# 20231230 removed:   QPATH/meta-rust 
BBLAYERS ?= " \
  QPATH/meta \
  QPATH/meta-oe \
  QPATH/meta-lts-mixins \
  QPATH/meta-python \
  QPATH/meta-perl \
  QPATH/meta-filesystems \
  QPATH/meta-networking \
  QPATH/meta-webserver \
  QPATH/meta-gnome \
  QPATH/meta-multimedia \
  QPATH/meta-poky \
  QPATH/meta-yocto-bsp \
  QPATH/meta-clang \
  QPATH/meta-xfce \
  QPATH/meta-qt5 \
  QPATH/meta-office \
  QPATH/meta-chromium \
  QPATH/meta-quirky \
  "
```
